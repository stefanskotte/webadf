// Pins floppy.pio's status_gate and flux_out PROGRAMS (not just the model in
// bus_model.c) to the encoding the shared-pad design depends on (spec
// 2026-10-08 §4 "PIO changes"): two SMs per program, one per drive, on one PIO,
// where the highest-numbered SM writing a pin wins and a pin nobody writes
// holds its level (RP2350 datasheet §11.2.6).
//
// bus_model.c checks what the programs DO, path by path; it never looks at the
// instruction words. A hand-edit that put `side 0` back on flux_out's `out`
// (a stalled SM then holds RDATA released over the other drive's pulse,
// §11.2.5), or made status_gate write `mov pins, null` on every released loop,
// would pass the model and break a two-drive board. So:
//
//  1. The golden arrays below are status_gate_program_instructions[] and
//     flux_out_program_instructions[] as pioasm emits them
//     (wifi-floppy/firmware/build/floppy.pio.h, generated by
//     `pico_generate_pio_header` during `pnpm firmware:build`). Regenerate by
//     running `pnpm firmware:build` and copying them here.
//  2. Structural checks on the arrays: lengths, and flux_out's side-set enable
//     (bit 12 under `.side_set 1 opt`) only on the pulse and its end.
//  3. If build/floppy.pio.h is present on disk, it is read as TEXT (it pulls in
//     hardware/pio.h, which needs the pico-sdk) and compared word by word.
//
// Change floppy.pio's status_gate/flux_out only together with bus_model.c,
// test_bus_model.c and these arrays.
#include "harness.h"
#include <stdbool.h>
#include <stdint.h>
#include <stdio.h>
#include <string.h>

#define STATUS_GATE_LEN 9
#define FLUX_OUT_LEN    7

static const uint16_t status_gate_golden[STATUS_GATE_LEN] = {
    0x8080, //  0: pull   noblock                 (top)
    0xa027, //  1: mov    x, osr
    0x00c6, //  2: jmp    pin, 6
    0xa001, //  3: mov    pins, x
    0xe041, //  4: set    y, 1
    0x0000, //  5: jmp    0
    0x0060, //  6: jmp    !y, 0                   (released)
    0xa003, //  7: mov    pins, null
    0xe040, //  8: set    y, 0
};

static const uint16_t flux_out_golden[FLUX_OUT_LEN] = {
    0x6121, //  0: out    x, 1                   [1]   (top)
    0x0025, //  1: jmp    !x, 5
    0x00c6, //  2: jmp    pin, 6
    0xba42, //  3: nop                    side 1 [2]
    0x1000, //  4: jmp    0               side 0
    0xa042, //  5: nop                                 (skip5)
    0xa342, //  6: nop                           [3]   (skip4)
};

// `.side_set 1 opt`: bit 12 is the side-set enable, bit 11 the value, bits
// [10:8] the delay.
static unsigned sideset_en(uint16_t w)  { return (w >> 12) & 1u; }
static unsigned sideset_val(uint16_t w) { return (w >> 11) & 1u; }
static unsigned delay_opt(uint16_t w)   { return (w >> 8) & 7u; }

static void flux_out_side_sets_only_the_pulse_and_its_end(void) {
    for (unsigned i = 0; i < FLUX_OUT_LEN; i++) {
        const bool want = i == 3 || i == 4;
        CHECK_EQ_INT(sideset_en(flux_out_golden[i]), want ? 1u : 0u);
    }
    CHECK_EQ_INT(sideset_val(flux_out_golden[3]), 1u);   // the pulse
    CHECK_EQ_INT(sideset_val(flux_out_golden[4]), 0u);   // its end
}

// The bit cell is the timing: 8 cycles on every path. Cycles = 1 + delay.
static void flux_out_every_path_is_8_cycles(void) {
    unsigned cyc[FLUX_OUT_LEN];
    for (unsigned i = 0; i < FLUX_OUT_LEN; i++) cyc[i] = 1u + delay_opt(flux_out_golden[i]);
    CHECK_EQ_INT(cyc[0] + cyc[1] + cyc[2] + cyc[3] + cyc[4], 8);   // 1, selected
    CHECK_EQ_INT(cyc[0] + cyc[1] + cyc[2] + cyc[6], 8);            // 1, deselected (skip4)
    CHECK_EQ_INT(cyc[0] + cyc[1] + cyc[5] + cyc[6], 8);            // 0 (skip5, skip4)
}

static void status_gate_writes_released_pads_once(void) {
    // jmp !y, top (JMP opcode 000, condition !Y = 011, target 0) guards the
    // only null write; nothing else in the released path writes pins.
    CHECK_EQ_INT(status_gate_golden[6], 0x0060u);
    CHECK_EQ_INT(status_gate_golden[7], 0xa003u);   // mov pins, null
    unsigned pin_writes = 0;
    for (unsigned i = 0; i < STATUS_GATE_LEN; i++)
        if ((status_gate_golden[i] >> 13) == 5u && ((status_gate_golden[i] >> 5) & 7u) == 0u) pin_writes++;
    CHECK_EQ_INT(pin_writes, 2u);                   // mov pins, x; mov pins, null
}

// Reads `name`'s words from build/floppy.pio.h into got[]; -1 if absent.
static int read_program(const char *name, uint16_t *got, int max) {
    FILE *f = fopen("../build/floppy.pio.h", "r");
    if (!f) return -1;
    char key[96], line[256];
    snprintf(key, sizeof key, "%s_program_instructions[] = {", name);
    int n = 0, in_array = 0;
    while (fgets(line, sizeof line, f)) {
        if (strstr(line, key)) { in_array = 1; continue; }
        if (!in_array) continue;
        if (strstr(line, "};")) break;
        char *p = line;
        while (*p == ' ') p++;
        unsigned word;
        if (sscanf(p, "0x%x,", &word) == 1 && n < max) got[n++] = (uint16_t)word;
    }
    fclose(f);
    return n;
}

static void the_generated_header_matches_the_golden_arrays_when_present(void) {
    uint16_t got[32];
    int n = read_program("status_gate", got, 32);
    if (n < 0) {
        printf("  (skip: ../build/floppy.pio.h not present -- run `pnpm firmware:build` first "
               "to check live, not just against the golden arrays)\n");
        return;
    }
    CHECK_EQ_INT(n, STATUS_GATE_LEN);
    for (int i = 0; i < n && i < STATUS_GATE_LEN; i++) CHECK_EQ_INT(got[i], status_gate_golden[i]);
    n = read_program("flux_out", got, 32);
    CHECK_EQ_INT(n, FLUX_OUT_LEN);
    for (int i = 0; i < n && i < FLUX_OUT_LEN; i++) CHECK_EQ_INT(got[i], flux_out_golden[i]);
}

int main(void) {
    RUN(flux_out_side_sets_only_the_pulse_and_its_end);
    RUN(flux_out_every_path_is_8_cycles);
    RUN(status_gate_writes_released_pads_once);
    RUN(the_generated_header_matches_the_golden_arrays_when_present);
    return REPORT();
}
